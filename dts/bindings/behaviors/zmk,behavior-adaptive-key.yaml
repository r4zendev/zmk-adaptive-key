## dts/bindings/behaviors/zmk,behavior-adaptive-key.yaml
```yaml
# Copyright (c) 2024 The ZMK Contributors
# SPDX-License-Identifier: MIT

description: Adaptive key behavior

compatible: "zmk,behavior-adaptive-key"

include: zero_param.yaml

properties:
  bindings:
    type: phandle-array
    description: |
      Default binding if no trigger condition is met.
    required: true
  dead-keys:
    type: array
    description: |
      List of key codes that are converted into dead keys.
    default: []
  delete-keycode:
    type: int
    description: |
      Keycode to press when delete-prior is set.
  skip-magic:
    type: boolean
    description: |
      If set, triggers match against the second-to-last keycode instead of the
      last keycode. When no trigger matches and a second-to-last keycode exists,
      that keycode is repeated (skip-repeat fallback).

child-binding:
  description: "An adaptive key condition"

  properties:
    bindings:
      type: phandle-array
      required: true
    trigger-keys:
      type: array
      required: true
    prior-trigger-keys:
      type: array
      default: []
      description: |
        Optional. When non-empty, the trigger fires only if the second-to-last
        keycode matches one of these, in addition to trigger-keys matching the
        last keycode. Enables AND-gated 2-keycode (prev + last) adaptive matching.
    max-prior-idle-ms:
      type: int
      default: -1
    min-prior-idle-ms:
      type: int
      default: -1
    delete-prior:
      type: boolean
    strict-modifiers:
      type: boolean
```
